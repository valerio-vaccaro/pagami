// Screen Info
#include <GxEPD.h>
//#include <GxGDE0213B1/GxGDE0213B1.h>      // 2.13" b/w
#include <GxGDEH0213B73/GxGDEH0213B73.h>    // ttgo t5
#include <GxIO/GxIO_SPI/GxIO_SPI.h>
#include <GxIO/GxIO.h>

// Fonts for text
#include <Adafruit_GFX.h>    // Core graphics library
#include <Fonts/FreeMono9pt7b.h>
#include <Fonts/FreeMonoBoldOblique9pt7b.h>
#include <Fonts/FreeMonoBold9pt7b.h>
#include <Fonts/FreeMonoOblique9pt7b.h>
#include <Fonts/FreeSans9pt7b.h>
#include <Fonts/FreeSansBold9pt7b.h>
#include <Fonts/FreeSansBoldOblique9pt7b.h>
#include <Fonts/FreeSansOblique9pt7b.h>
#include <Fonts/FreeSerif9pt7b.h>
#include <Fonts/FreeSerifBold9pt7b.h>
#include <Fonts/FreeSerifBoldItalic9pt7b.h>
#include <Fonts/FreeSerifItalic9pt7b.h>

#include "time.h"

// define pins to match your wiring
#define PIN_CS    SS
#define PIN_DC    17
#define PIN_RST   16
#define PIN_BUSY  4

const GFXfont *fonts[] = {
  &FreeMono9pt7b,
  &FreeMonoBoldOblique9pt7b,
  &FreeMonoBold9pt7b,
  &FreeMonoOblique9pt7b,
  &FreeSans9pt7b,
  &FreeSansBold9pt7b,
  &FreeSansBoldOblique9pt7b,
  &FreeSansOblique9pt7b,
  &FreeSerif9pt7b,
  &FreeSerifBold9pt7b,
  &FreeSerifBoldItalic9pt7b,
  &FreeSerifItalic9pt7b
};

GxIO_Class io(SPI, PIN_CS, PIN_DC, PIN_RST);
GxEPD_Class display(io, PIN_RST, PIN_BUSY);

// QR code lib
#include "qrcode.h"

const uint8_t image[] PROGMEM = {
  0x0, 0x0, 0x0, 0x0, 0x0, 0x0, 0x0, 0x0, 0x0, 0x0, 0x0, 0x0, 0x0,
  0x0, 0x0, 0x0, 0x0, 0x0, 0x7f, 0xff, 0xe0, 0x0, 0x0, 0x0, 0x0, 0x0,
  0x0, 0x0, 0x0, 0x0, 0x7, 0xff, 0xff, 0xfe, 0x0, 0x0, 0x0, 0x0, 0x0,
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  0x0, 0x0, 0x0, 0x0, 0x0, 0x0, 0x0, 0x0, 0x0, 0x0, 0x0, 0x0, 0x0
};

void Message(char* row1, char* row2, char* row3, char* row4) {
  display.fillRect(0, 0, GxEPD_HEIGHT, GxEPD_WIDTH, GxEPD_WHITE);
  display.drawBitmap(0, 20, image, 100, 100, GxEPD_BLACK);
  display.setCursor(5, 15);
  display.println("PAGAMI.ORG");
  display.setCursor(110, 40);
  display.println(row1);
  display.setCursor(110, 60);
  display.println(row2);
  display.setCursor(110, 80);
  display.println(row3);
  display.setCursor(110, 100);
  display.println(row4);
  struct tm timeinfo;
  if (getLocalTime(&timeinfo)) {
    char buffer[100];
    strftime(buffer, sizeof(buffer), "%d/%m/%Y %H:%M", &timeinfo);
    display.setCursor(110, 120);
    display.println(buffer);
  }
  // Update Display
  display.update();
}

void QR(char* address, char* row1, char* row2, char* row3, char* row4) {
  // Clear screen
  display.fillRect(0, 0, GxEPD_HEIGHT, GxEPD_WIDTH, GxEPD_WHITE);

  // Start time
  uint32_t dt = millis();

  byte box_x = 5;
  byte box_y = 5;
  byte box_s = 3.5;
  byte init_x = box_x;

  // Create the QR code
  QRCode qrcode;
  uint8_t qrcodeData[qrcode_getBufferSize(5)];
  qrcode_initText(&qrcode, qrcodeData, 3, ECC_LOW, address);

  for (uint8_t y = 0; y < qrcode.size; y++) {
    for (uint8_t x = 0; x < qrcode.size; x++) {
      if (qrcode_getModule(&qrcode, x, y))
        display.fillRect(5 + box_x, 20 + box_y, box_s, box_s, GxEPD_BLACK);
      box_x = box_x + box_s;
    }
    box_y = box_y + box_s;
    box_x = init_x;
  }
  display.setCursor(5, 15);
  display.println("PAGAMI.ORG");
  display.setCursor(110, 40);
  display.println(row1);
  display.setCursor(110, 60);
  display.println(row2);
  display.setCursor(110, 80);
  display.println(row3);
  display.setCursor(110, 100);
  display.println(row4);
  struct tm timeinfo;
  if (getLocalTime(&timeinfo)) {
    char buffer[100];
    strftime(buffer, sizeof(buffer), "%d/%m/%Y %H:%M", &timeinfo);
    display.setCursor(110, 120);
    display.println(buffer);
  }
  // Update Display
  display.update();
}
